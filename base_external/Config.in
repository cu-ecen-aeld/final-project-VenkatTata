## base_external/Config.in
```kconfig
source "$BR2_EXTERNAL_assignment_base_PATH/package/aesdi2ctemp/Config.in"
source "$BR2_EXTERNAL_assignment_base_PATH/package/bttest/Config.in"
```

## base_external/package/bttest/Config.in
```kconfig
config BR2_PACKAGE_AESDI2CTEMP
	bool "aesdi2ctemp"
	help
	  Includes the i2c userland executable which detects, reads and writes to the TMP102 I2C based sensor
```
